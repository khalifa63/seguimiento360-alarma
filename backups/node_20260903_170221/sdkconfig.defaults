## backups/node_20260903_170221/sdkconfig.defaults
```kconfig
# === Target ESP32-C3 ===
CONFIG_IDF_TARGET="esp32c3"

# === Flash 4MB (XMC) ===
CONFIG_ESPTOOLPY_FLASHSIZE_4MB=y
CONFIG_ESPTOOLPY_FLASHMODE_DIO=y
CONFIG_ESPTOOLPY_FLASHFREQ_80M=y

# === WiFi ===
CONFIG_ESP_WIFI_STATIC_RX_BUFFER_NUM=10
CONFIG_ESP_WIFI_DYNAMIC_RX_BUFFER_NUM=32
CONFIG_ESP_WIFI_DYNAMIC_TX_BUFFER_NUM=32
CONFIG_ESP_WIFI_NVS_ENABLED=y

# === ESP-NOW ===
CONFIG_ESP_WIFI_ENABLE_WPA3_SAE=n

# === FreeRTOS ===
CONFIG_FREERTOS_HZ=1000

# === Logging ===
CONFIG_LOG_DEFAULT_LEVEL_INFO=y
```

## firmware/hub/sdkconfig.defaults
```kconfig
# === Target ===
CONFIG_IDF_TARGET="esp32s3"

# === Partition table (M1, A3 v0.1) ===
CONFIG_PARTITION_TABLE_CUSTOM=y
CONFIG_PARTITION_TABLE_CUSTOM_FILENAME="partitions.csv"
CONFIG_PARTITION_TABLE_FILENAME="partitions.csv"

# === Flash 16MB (detectado en hardware M1) ===
CONFIG_ESPTOOLPY_FLASHSIZE_16MB=y

# === PSRAM (buffers TLS en PSRAM - A3 v0.1) ===
CONFIG_SPIRAM=y
CONFIG_SPIRAM_MODE_OCT=y
CONFIG_SPIRAM_SPEED_80M=y
CONFIG_SPIRAM_USE_MALLOC=y
CONFIG_SPIRAM_MALLOC_ALWAYSINTERNAL=4096

# === FreeRTOS / WDT ===
CONFIG_FREERTOS_HZ=1000
CONFIG_FREERTOS_UNICORE=n
CONFIG_FREERTOS_TIMER_TASK_STACK_DEPTH=4096
CONFIG_ESP_TASK_WDT_TIMEOUT_S=10
CONFIG_ESP_TASK_WDT_CHECK_IDLE_TASK_CPU0=y
CONFIG_ESP_TASK_WDT_CHECK_IDLE_TASK_CPU1=y

# === NVS ===
CONFIG_NVS_ENABLED=y

# === WiFi (M2) ===
CONFIG_ESP_WIFI_SOFTAP_SUPPORT=n
CONFIG_ESP_WIFI_NVS_ENABLED=y
CONFIG_ESP_WIFI_STATIC_RX_BUFFER_NUM=10
CONFIG_ESP_WIFI_DYNAMIC_RX_BUFFER_NUM=32

# === mbedTLS (WSS - INFRA-REAL v1.0) ===
CONFIG_MBEDTLS_CERTIFICATE_BUNDLE=y
CONFIG_MBEDTLS_CERTIFICATE_BUNDLE_DEFAULT_FULL=y
CONFIG_MBEDTLS_HARDWARE_AES=y
CONFIG_MBEDTLS_HARDWARE_SHA=y

# === MQTT (WSS) ===
CONFIG_MQTT_TRANSPORT_SSL=y
CONFIG_MQTT_TRANSPORT_WEBSOCKET=y
CONFIG_MQTT_WEBSOCKET_OVER_SSL=y
CONFIG_MQTT_BUFFER_SIZE=2048

# === ESP-TLS ===
CONFIG_ESP_TLS_USING_MBEDTLS=y

# === Logging ===
CONFIG_LOG_DEFAULT_LEVEL_INFO=y
CONFIG_LOG_DEFAULT_LEVEL=3
CONFIG_LOG_MAXIMUM_LEVEL_DEBUG=y

# === System ===
CONFIG_ESP_SYSTEM_EVENT_TASK_STACK_SIZE=4096
```
