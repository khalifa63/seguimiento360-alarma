## firmware/esp32cam-evidence/sdkconfig.defaults
```kconfig
# ESP32-CAM Evidence - sdkconfig defaults
CONFIG_ESPTOOLPY_MONITOR_BAUD=115200
CONFIG_PARTITION_TABLE_CUSTOM_FILENAME="partitions.csv"
CONFIG_ESP32_DEFAULT_CPU_FREQ_240=y
CONFIG_ESP32_SPIRAM_SUPPORT=y
CONFIG_SPIRAM_USE_MALLOC=y
CONFIG_SPIRAM_CACHE_WORKAROUND=y
CONFIG_ESP_CAMERA_ENABLE=y
CONFIG_ESP_CAMERA_FB_COUNT=1
CONFIG_ESP_CAMERA_GRAB_LATEST=y
CONFIG_ESP_CAMERA_XCLK_FREQ_HZ=10000000
CONFIG_ESP_CAMERA_FRAME_SIZE_SVGA=y
CONFIG_ESP_CAMERA_JPEG_QUALITY=12
CONFIG_SD_MMC_HOST_ENABLED=y
CONFIG_SD_MMC_1BIT_MODE=y
CONFIG_SD_MMC_SPEED_20MHZ=y
CONFIG_ESP_HTTPS_OTA=y
CONFIG_ESP_HTTPS_SERVER=y
CONFIG_MBEDTLS_SSL_INSECURE=y
CONFIG_ESP_CRT_BUNDLE=y
CONFIG_LOG_DEFAULT_LEVEL_INFO=y
CONFIG_LOG_MAXIMUM_LEVEL_VERBOSE=y
CONFIG_FREERTOS_HZ=1000
CONFIG_ESP_SYSTEM_PANIC_PRINT_HALT=y
CONFIG_ESP_SYSTEM_PANIC_SILENT_REBOOT=n
```
